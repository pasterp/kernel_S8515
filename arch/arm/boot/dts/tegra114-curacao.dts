/*
 * arch/arm/boot/dts/tegra114-curacao.dts
 *
 * Copyright (C) 2013-2014 NVIDIA Corporation. All rights reserved.
 *
 * This software is licensed under the terms of the GNU General Public
 * License version 2, as published by the Free Software Foundation, and
 * may be copied, distributed, and modified under those terms.
 *
 * This program is distributed in the hope that it will be useful,
 * but WITHOUT ANY WARRANTY; without even the implied warranty of
 * MERCHANTABILITY or FITNESS FOR A PARTICULAR PURPOSE.  See the
 * GNU General Public License for more details.
 *
 */

/dts-v1/;

/include/ "tegra114.dtsi"

/ {
	model = "NVIDIA Tegra114 curacao evaluation board";
	compatible = "nvidia,curacao", "nvidia,tegra114";
};
